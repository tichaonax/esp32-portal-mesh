## sdkconfig.defaults
```kconfig
# ESP32 Mesh Configuration
CONFIG_ESP_WIFI_ENABLED=y
CONFIG_ESP_WIFI_SOFTAP_SUPPORT=y
CONFIG_ESP_WIFI_STA_SUPPORT=y

# Mesh Networking
CONFIG_ESP_WIFI_MESH_ENABLE=y
CONFIG_ESP_WIFI_MESH_MAX_LAYER=4
CONFIG_ESP_WIFI_MESH_CHANNEL=1
CONFIG_ESP_WIFI_MESH_ROUTER_SSID="MyRouter"
CONFIG_ESP_WIFI_MESH_ROUTER_PASSWD="password"
CONFIG_ESP_WIFI_MESH_AP_AUTHMODE=WIFI_AUTH_WPA2_PSK
CONFIG_ESP_WIFI_MESH_AP_PASSWD="meshpassword"
CONFIG_ESP_WIFI_MESH_AP_CONNECTIONS=5

# Wi-Fi
CONFIG_ESP_WIFI_STATIC_RX_BUFFER_NUM=16
CONFIG_ESP_WIFI_DYNAMIC_RX_BUFFER_NUM=32
CONFIG_ESP_WIFI_DYNAMIC_TX_BUFFER_NUM=32
CONFIG_ESP_WIFI_TX_BUFFER_TYPE=1
CONFIG_ESP_WIFI_CACHE_TX_BUFFER_NUM=32

# NAT (NAPT) for internet routing
CONFIG_LWIP_IPV4_NAPT=y
CONFIG_LWIP_IP_FORWARD=y

# FreeRTOS
CONFIG_FREERTOS_HZ=100

# Logging
CONFIG_LOG_DEFAULT_LEVEL_INFO=y
```
